## conf/layer.conf
```bitbake
# SPDX-License-Identifier: MIT
BBPATH .= ":${LAYERDIR}"
BBFILES += "${LAYERDIR}/recipes-*/*/*.bb ${LAYERDIR}/recipes-*/*/*.bbappend"
BBFILE_COLLECTIONS += "fractalmicro_openh432"
BBFILE_PATTERN_fractalmicro_openh432 = "^${LAYERDIR}/"
BBFILE_PRIORITY_fractalmicro_openh432 = "7"
LAYERDEPENDS_fractalmicro_openh432 = "core"
LAYERSERIES_COMPAT_fractalmicro_openh432 = "wrynose"
```
